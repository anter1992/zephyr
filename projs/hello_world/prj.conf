## CMakeLists.txt
```
# SPDX-License-Identifier: Apache-2.0

cmake_minimum_required(VERSION 3.20.0)

find_package(Zephyr REQUIRED HINTS $ENV{ZEPHYR_BASE})
project(hello_world)

target_sources(app PRIVATE src/main.cpp
                src/ReadClass.cpp 
                src/ReactClass.cpp)
```

## prj.conf
```kconfig
# Using old revision of esp32 so this flag has to be enabled, will not flash otherwise
CONFIG_ESP32_USE_UNSUPPORTED_REVISION=y
CONFIG_ZBUS=y
```

## src/main.cpp
```c
/**
 * @file main.cpp
 * @brief Implementation of the pep task.
 *
 * This file contains the main implementation of the pep task. The task handles readings from the input
 * of one GPIO and based on the input value performs LED on/off operation on the second GPIO configured as output.
 * The code involves interaction with hardware peripherals and GPIO pins, with special attention to the ESP32 GPIO reservation settings.
 * To build thsi project, use the following command:
 * 	west build -b esp32_devkitc_wroom/esp32/procpu [proj_path]
 * 
 * @note
 * 	 - The LED and BUTTON overlay configuration for ESP32 was not successful. 
 *   Although I am "familiar" with how the overlay should work, I chose not to spend additional time on this.
 *
 * Reserved GPIO pins for ESP32:
 * 
 * &gpio0 {
 *     gpio-reserved-ranges = <6 6>, // flash
 *                            <20 1>, <24 1>, <28 4>; // NC
 * };
 * 
 * &gpio1 {
 *     gpio-reserved-ranges = <5 2>; // GPIO37-38 NC
 * };
 */

#include <zephyr/device.h>
#include <zephyr/kernel.h>
#include <zephyr/drivers/gpio.h>
#include <stdio.h>
#include <zephyr/zbus/zbus.h>
#include "ReadClass.h"
#include "ReactClass.h"


#define REACT_PIN_OUT 25
#define READ_PIN_IN 27

/* 	Device which hold the pin configuration, for this purpose esp32 on gpio0 has 32
	pins so only gpio0 is needed */
static const struct device *gpio_dev = DEVICE_DT_GET(DT_NODELABEL(gpio0));

/* Classes instances are declared here because of the notification callback, it uses ReactClass instance */
static ReadClass read_class(gpio_dev, READ_PIN_IN);
static ReactClass react_class(gpio_dev, REACT_PIN_OUT);


void gpioInputNotificationCallback(const struct zbus_channel *chan);

/**
 * @brief
 * zBus channel used for communication of input level value.
 */
ZBUS_CHAN_DEFINE(gpio_input_data_chan,      /* Name */
                 uint8_t,                    /* Message type */
                 NULL,                       /* Validator */
                 NULL,                       /* User data */
                 ZBUS_OBSERVERS(gpioInObs), /* Observers */
                 ZBUS_MSG_INIT(0));          /* Initial value */

/**
 * @brief
 * zBus gpio_input_data_chan notification callback
 */
ZBUS_LISTENER_DEFINE(gpioInObs, gpioInputNotificationCallback);

int main(void) {	
	/* Check if gpio can be used */
	if(!device_is_ready(gpio_dev)) {
		printf("Device not ready");
		return 0;
	}
	// Initialize ReadClass and ReactClass
	read_class.init();
	react_class.init();

	// Loop for the app to run
	while(1){}
	return 0;
}

/**
 * @brief Callback function for GPIO input interrupt notifications.
 */
void gpioInputNotificationCallback(const struct zbus_channel *chan) {
    const uint8_t *inputLevel = (uint8_t*)zbus_chan_const_msg(chan);
	if(inputLevel){
		react_class.handleNotification(inputLevel);
	}
}
```

## src/ReactClass.cpp
```c
/**
 * @file ReactClass.cpp
 * @brief Implementation LED toggling based on input level.
 *
 */
#include "ReactClass.h"


ReactClass::ReactClass(const struct device *gpio_dev, uint8_t pin): gpio_dev(gpio_dev), pin(pin),
                    inputLevel_(0) {};


void ReactClass::init() {
    gpio_pin_configure(gpio_dev, pin, GPIO_OUTPUT_INACTIVE);
    // Add worker which will handle toggling of LED
    k_work_init_delayable(&my_work, notificationWorkHandler);

};

void ReactClass::handleNotification(const uint8_t *inputLevel) {

    if(inputLevel) {
        inputLevel_ = *inputLevel;
        /*Submit the work item for processing later. This sort of handles the debouncing as well
          since in case before the timeout the notification is received, it will cancel the one waiting 
          and start the new one */
        k_work_schedule(&my_work, K_MSEC(500));
    }
}

void ReactClass::notificationWorkHandler(struct k_work *work) {
    uint8_t inputVal = 0;
    // Obtain the instance which holds the work value
    ReactClass *obj = CONTAINER_OF(work, ReactClass, my_work);

    // Check that the instance was actually found
    if(obj) {
        if(obj->inputLevel_){
        // If the state is high, blink the LED 3 times with 100ms between each blink
		printf("Input high start ;\n");
        for (uint8_t i = 0; i < 3; i++) {
            gpio_pin_set(obj->gpio_dev, obj->pin, 1);
            k_msleep(100);
            gpio_pin_set(obj->gpio_dev, obj->pin, 0);
            k_msleep(100);
        }
        printf("Input high end ;\n");

        } else {
            printf("Input low start ;\n");	
            gpio_pin_set(obj->gpio_dev, obj->pin , 1);
            k_msleep(500);
            gpio_pin_set(obj->gpio_dev, obj->pin, 0);
            printf("Input low end ;\n");	
        }

    } else{
        printf("Device not ready");
    }    
}
```

## src/ReactClass.h
```c
#ifndef REACTCLASS_H
#define REACTCLASS_H
#include <zephyr/device.h>
#include <zephyr/kernel.h>
#include <zephyr/drivers/gpio.h>
#include <stdio.h>
#include <zephyr/zbus/zbus.h>

class ReactClass {
private:
    // Device containing the gpio configuration
    const struct device *gpio_dev;
    // Pin of the input
    uint8_t pin;
    // input level
    uint8_t inputLevel_;
    // Worker for the notification of pin change
    k_work_delayable my_work;

    static void notificationWorkHandler(struct k_work *work); // Work handler function

public:
    /**
     * @brief ReadClass - Handles GPIO input reading and triggering events.
     */
    ReactClass(const struct device *gpio_dev, uint8_t pin);

    /**
     * @brief Set up GPIO input with pull-up and interrupt.
     */
    void init();
    void handleNotification(const uint8_t *inputLevel);
};

#endif
```

## src/ReadClass.cpp
```c
/**
 * @file ReadClass.cpp
 * @brief Implementation of interrupt handling for GPIO configured as input
 *          and notifying subsribers about the input value read
 *
 */
#include "ReadClass.h"

extern struct zbus_channel gpio_input_data_chan; // Channel

ReadClass::ReadClass(const struct device *gpio_dev, uint8_t pin): gpio_dev(gpio_dev), pin(pin) {};

void ReadClass::init() {
    /*  Board has internal pull-up/down resistors of 45kOhm so we can use that and avout the need for 
	external ones for the input check*/
	gpio_pin_configure(gpio_dev, pin, GPIO_INPUT | GPIO_PULL_UP);
	// Register the interrupt callback, since we are checking highs and lows, GPIO_INT_EDGE_BOTH is used
    gpio_pin_interrupt_configure(gpio_dev, pin, GPIO_INT_EDGE_BOTH);
	gpio_init_callback(&cb_data, button_pressed, BIT(pin));
    gpio_add_callback(gpio_dev, &cb_data);
    // Add worker which will notify subscribers on input change
    k_work_init(&notification_work, notificationWorkHandler);
};

void ReadClass::button_pressed(const struct device *dev,
		    struct gpio_callback *cb,
		    uint32_t pins) {
    // Obtain the instance which holds the cb value
    ReadClass *obj = CONTAINER_OF(cb, ReadClass, cb_data);

    // Check that the instance was actually found
    if(obj) {
        // Submit the work item for processing later
        k_work_submit(&obj->notification_work); 
    } else{
        printf("Device not ready");
    }
}


void ReadClass::notificationWorkHandler(struct k_work *work) {
    uint8_t inputVal = 0;
    // Obtain the instance which holds the work value
    ReadClass *obj = CONTAINER_OF(work, ReadClass, notification_work);

    // Check that the instance was actually found
    if(obj) {
        //Read the input
        inputVal = gpio_pin_get(obj->gpio_dev, obj->pin);
        // Notify observers of input value
        zbus_chan_pub(&gpio_input_data_chan, &inputVal, K_SECONDS(1));
    } else{
        printf("Device not ready");
    }    
}
```

## src/ReadClass.h
```c
#ifndef READCLASS_H
#define READCLASS_H
#include <zephyr/device.h>
#include <zephyr/kernel.h>
#include <zephyr/drivers/gpio.h>
#include <stdio.h>
#include <zephyr/zbus/zbus.h>

class ReadClass {
private:
    // Device containing the gpio configuration
    const struct device *gpio_dev;
    // Callback data from the gpio interrupt
    struct gpio_callback cb_data;
    // Pin of the input
    uint8_t pin;
    // Worker for the notification of pin change
    k_work notification_work;

    /**
     * @brief Callback function when the interrupt occurs.
     */
    static void button_pressed(const struct device *dev,
		    struct gpio_callback *cb,
		    uint32_t pins);
    
    /**
    * @brief Callback function when the interrupt occurs.
    */
    static void notificationWorkHandler(struct k_work *work); // Work handler function


public:
    /**
     * @brief ReadClass - Handles GPIO input reading and triggering events.
     */
    ReadClass(const struct device *gpio_dev, uint8_t pin);

    /**
     * @brief Set up GPIO input with pull-up and interrupt.
     */
    void init();
};

#endif
```
