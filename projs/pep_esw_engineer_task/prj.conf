## CMakeLists.txt
```
# SPDX-License-Identifier: Apache-2.0

cmake_minimum_required(VERSION 3.20.0)

find_package(Zephyr REQUIRED HINTS $ENV{ZEPHYR_BASE})
project(pep_esw_engineer_task)
include_directories(${CMAKE_SOURCE_DIR}/inc)
target_sources(app PRIVATE src/main.cpp
                src/ReadClass.cpp 
                src/ReactClass.cpp)
```

## prj.conf
```kconfig
# Using old revision of esp32 so this flag has to be enabled, will not flash otherwise
CONFIG_ESP32_USE_UNSUPPORTED_REVISION=y
CONFIG_ZBUS=y
CONFIG_STATIC_INIT_GNU=y
```

## inc/ReadClass.h
```c
#ifndef READCLASS_H
#define READCLASS_H
#include <zephyr/device.h>
#include <zephyr/kernel.h>
#include <zephyr/drivers/gpio.h>
#include <stdio.h>
#include <zephyr/zbus/zbus.h>

class ReadClass {
private:
    // Device object containing the GPIO configuration
    const struct device *gpio_dev;
    
    // GPIO interrupt callback data
    struct gpio_callback cb_data;
    
    // Pin number used for GPIO input
    uint8_t pin;
    
    // Worker for handling pin change notifications
    k_work notification_work;

    /**
     * @brief Callback function that is invoked when the interrupt occurs on the GPIO pin.
     */
    static void button_pressed(const struct device *dev,
                               struct gpio_callback *cb,
                               uint32_t pins);

    /**
     * @brief Work handler function that processes the GPIO input change.
     */
    static void notificationWorkHandler(struct k_work *work);

public:
    /**
     * @brief Constructor for the ReadClass object.
     */
    ReadClass(const struct device *gpio_dev, uint8_t pin);

    /**
     * @brief Initializes the GPIO input with pull-up configuration and interrupt.
     */
    void init();
};

#endif
```

## src/ReactClass.cpp
```c
/**
 * @file ReactClass.cpp
 * @brief Implementation LED toggling based on input level.
 *
 */
#include "ReactClass.h"


ReactClass::ReactClass(const struct device *gpio_dev, uint8_t pin): gpio_dev(gpio_dev), pin(pin),
                    inputLevel_(0) {};


void ReactClass::init() {
    gpio_pin_configure(gpio_dev, pin, GPIO_OUTPUT_INACTIVE);
    // Add worker which will handle toggling of LED
    k_work_init_delayable(&my_work, notificationWorkHandler);

};

void ReactClass::handleNotification(const uint8_t *inputLevel) {

    if(inputLevel) {
        inputLevel_ = *inputLevel;
        /*Submit the work item for processing later. This sort of handles the debouncing as well
          since in case before the timeout the notification is received, it will cancel the one waiting 
          and start the new one */
        k_work_schedule(&my_work, K_MSEC(500));
    }
}

void ReactClass::notificationWorkHandler(struct k_work *work) {
    uint8_t inputVal = 0;
    // Obtain the instance which holds the work value
    ReactClass *obj = CONTAINER_OF(work, ReactClass, my_work);

    // Check that the instance was actually found
    if(obj) {
        if(obj->inputLevel_){
        // If the state is high, blink the LED 3 times with 100ms between each blink
		printf("Input high start ;\n");
        for (uint8_t i = 0; i < 3; i++) {
            gpio_pin_set(obj->gpio_dev, obj->pin, 1);
            k_msleep(100);
            gpio_pin_set(obj->gpio_dev, obj->pin, 0);
            k_msleep(100);
        }
        printf("Input high end ;\n");

        } else {
            printf("Input low start ;\n");	
            gpio_pin_set(obj->gpio_dev, obj->pin , 1);
            k_msleep(500);
            gpio_pin_set(obj->gpio_dev, obj->pin, 0);
            printf("Input low end ;\n");	
        }

    } else{
        printf("obj not found!\n");
    }    
}
```

## src/ReactClass.h
```c
#ifndef REACTCLASS_H
#define REACTCLASS_H
#include <zephyr/device.h>
#include <zephyr/kernel.h>
#include <zephyr/drivers/gpio.h>
#include <stdio.h>
#include <zephyr/zbus/zbus.h>

class ReactClass {
private:
    // Device containing the gpio configuration
    const struct device *gpio_dev;
    // Pin of the input
    uint8_t pin;
    // input level
    uint8_t inputLevel_;
    // Worker for the notification of pin change
    k_work_delayable my_work;

    static void notificationWorkHandler(struct k_work *work); // Work handler function

public:
    /**
     * @brief ReadClass - Handles GPIO input reading and triggering events.
     */
    ReactClass(const struct device *gpio_dev, uint8_t pin);

    /**
     * @brief Initializes the GPIO output and worker to handle the led blinking.
     */
    void init();

    /**
     * @brief Handler for the notification channel which calls the worker to handle LED blinking
     */
    void handleNotification(const uint8_t *inputLevel);
};

#endif
```

## src/ReadClass.cpp
```c
/**
 * @file ReadClass.cpp
 * @brief Implementation of interrupt handling for GPIO configured as input
 *          and notifying subsribers about the input value read
 *
 */
#include "ReadClass.h"

extern struct zbus_channel gpio_input_data_chan; // Channel

ReadClass::ReadClass(const struct device *gpio_dev, uint8_t pin): gpio_dev(gpio_dev), pin(pin) {};

void ReadClass::init() {
    /*  Board has internal pull-up/down resistors of 45kOhm so we can use that and avout the need for 
	external ones for the input check*/
	gpio_pin_configure(gpio_dev, pin, GPIO_INPUT | GPIO_PULL_UP);
	// Register the interrupt callback, since we are checking highs and lows, GPIO_INT_EDGE_BOTH is used
    gpio_pin_interrupt_configure(gpio_dev, pin, GPIO_INT_EDGE_BOTH);
	gpio_init_callback(&cb_data, button_pressed, BIT(pin));
    gpio_add_callback(gpio_dev, &cb_data);
    // Add worker which will notify subscribers on input change
    k_work_init(&notification_work, notificationWorkHandler);
};

void ReadClass::button_pressed(const struct device *dev,
		    struct gpio_callback *cb,
		    uint32_t pins) {
    // Obtain the instance which holds the cb value
    ReadClass *obj = CONTAINER_OF(cb, ReadClass, cb_data);

    // Check that the instance was actually found
    if(obj) {
        // Submit the work item for processing later
        k_work_submit(&obj->notification_work); 
    } else{
        printf("obj not found!\n");
    }
}


void ReadClass::notificationWorkHandler(struct k_work *work) {
    uint8_t inputVal = 0;
    // Obtain the instance which holds the work value
    ReadClass *obj = CONTAINER_OF(work, ReadClass, notification_work);

    // Check that the instance was actually found
    if(obj) {
        //Read the input
        inputVal = gpio_pin_get(obj->gpio_dev, obj->pin);
        // Notify observers of input value
        zbus_chan_pub(&gpio_input_data_chan, &inputVal, K_SECONDS(1));
    } else{
        printf("obj not found!\n");
    }    
}
```
